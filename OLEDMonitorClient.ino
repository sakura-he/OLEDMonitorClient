#include <ESP8266WiFi.h>
#include <Ticker.h>
#include <U8g2lib.h>
#include <sstream>
#include <string.h>
#include <math.h> /* round, floor, ceil, trunc */
#include <stdio.h>
String infoArr[3][6]; // 存放从服务器获取到的数据
U8G2_SSD1306_128X64_NONAME_F_HW_I2C u8g2(U8G2_R0, /* reset=*/U8X8_PIN_NONE);
// 图标
// active
const unsigned char link[] U8X8_PROGMEM = {0x00, 0x00, 0x00, 0x00, 0x00, 0x00, 0xf0, 0x01, 0x00, 0x00, 0xfc, 0x07, 0x00,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 0x00, 0x00};
const unsigned char wifi2[] U8X8_PROGMEM = {0x00, 0x00, 0x00, 0x00, 0x00, 0x00, 0x00, 0x00, 0x00, 0x00, 0x00, 0x00, 0x00,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 0x00, 0x00};
const unsigned char active[] U8X8_PROGMEM = {0x00, 0x00, 0x00, 0x00, 0x00, 0x00, 0x00, 0x00, 0x00, 0x00, 0x00, 0x00, 0x00,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 0x00, 0x00};
const unsigned char cpu[] U8X8_PROGMEM = {0x00, 0x38, 0x38, 0x00, 0x00, 0x38, 0x38, 0x00, 0x00, 0x38, 0x38, 0x00, 0x00,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 0x38, 0x00};
const unsigned char box[] U8X8_PROGMEM = {0x00, 0x00, 0x00, 0x00, 0x00, 0xc0, 0x03, 0x00, 0x00, 0xf0, 0x0f, 0x00, 0x00,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 0x00, 0x00};
const unsigned char database[] U8X8_PROGMEM = {0x00, 0x00, 0x00, 0x00, 0x00, 0xf8, 0x1f, 0x00, 0xc0, 0xff, 0xff, 0x03, 0xf0,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 0x00, 0x00};
const unsigned char drive[] U8X8_PROGMEM = {0x00, 0x00, 0x00, 0x00, 0x00, 0x00, 0x00, 0x00, 0x00, 0x00, 0x00, 0x00, 0x00,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 0x00, 0x00};
const unsigned char global[] U8X8_PROGMEM = {0x00, 0x00, 0x00, 0x00, 0x00, 0xf0, 0x0f, 0x00, 0x00, 0xfe, 0x7f, 0x00, 0x00,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 0x00, 0x00};
const unsigned char nodejs[] U8X8_PROGMEM = {0x00, 0x00, 0x00, 0x00, 0x00, 0xc0, 0x03, 0x00, 0x00, 0xf0, 0x0f, 0x00, 0x00,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 0x00, 0x00};
const unsigned char server[] U8X8_PROGMEM = {0x00, 0x00, 0x00, 0x00, 0xfe, 0xff, 0xff, 0x7f, 0xfe, 0xff, 0xff, 0x7f, 0xfe,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 0x00, 0x00};
const unsigned char terminal[] U8X8_PROGMEM = {0x00, 0x00, 0x00, 0x00, 0x00, 0x00, 0x00, 0x00, 0x00, 0x00, 0x00, 0x00, 0x00,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 0x00, 0x00};
const unsigned char thermomete[] U8X8_PROGMEM = {0x00, 0xf8, 0x0f, 0x00, 0x00, 0xf8, 0x0f, 0x00, 0x00, 0x18, 0x0c, 0x00, 0x00,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 0x07, 0x00};
const unsigned char wifi[] U8X8_PROGMEM = {0x00, 0x00, 0x00, 0x00, 0x00, 0x00, 0x00, 0x00, 0x00, 0x00, 0x00, 0x00, 0x00,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 0x00, 0x00};
// 图标数组 icon array
const unsigned char *const iconList[] U8X8_PROGMEM = {active, cpu, box, database, drive, global, nodejs, server, terminal, thermomete, wifi, link, wifi2};
// 加载动画列表loding bmp list
const unsigned char load1[] U8X8_PROGMEM = {0x00, 0x00, 0x00, 0x00, 0x00, 0x00, 0x00, 0x00, 0x00, 0x00, 0x00, 0x00, 0x00,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 0x00, 0x00};
const unsigned char load2[] U8X8_PROGMEM = {0x00, 0x00, 0x00, 0x00, 0x00, 0x00, 0x00, 0x00, 0x00, 0x00, 0x00, 0x00, 0x00,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 0x00, 0x00};
const unsigned char load3[] U8X8_PROGMEM = {0x00, 0x00, 0x00, 0x00, 0x00, 0x00, 0x00, 0x00, 0x00, 0x00, 0x00, 0x00, 0x00,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 0x00, 0x00};
const unsigned char load4[] U8X8_PROGMEM = {0x00, 0x00, 0x00, 0x00, 0x00, 0x00, 0x00, 0x00, 0x00, 0x00, 0x00, 0x00, 0x00,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 0x00, 0x00};
const unsigned char load5[] U8X8_PROGMEM = {0x00, 0x00, 0x00, 0x00, 0x00, 0x00, 0x00, 0x00, 0x00, 0x00, 0x00, 0x00, 0x00,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 0x00, 0x00};
const unsigned char load6[] U8X8_PROGMEM = {0x00, 0x00, 0x00, 0x00, 0x00, 0x00, 0x00, 0x00, 0x00, 0x00, 0x00, 0x00, 0x00,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 0x00, 0x00};
const unsigned char load7[] U8X8_PROGMEM = {0x00, 0x00, 0x00, 0x00, 0x00, 0x00, 0x00, 0x00, 0x00, 0x00, 0x00, 0x00, 0x00,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 0x00, 0x00};
const unsigned char load8[] U8X8_PROGMEM = {0x00, 0x00, 0x00, 0x00, 0x00, 0x00, 0x00, 0x00, 0x00, 0x00, 0x00, 0x00, 0x00,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 0x00, 0x00};
const unsigned char load9[] U8X8_PROGMEM = {0x00, 0x00, 0x00, 0x00, 0x00, 0x00, 0x00, 0x00, 0x00, 0x00, 0x00, 0x00, 0x00,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 0x00, 0x00};
const unsigned char load10[] U8X8_PROGMEM = {0x00, 0x00, 0x00, 0x00, 0x00, 0x00, 0x00, 0x00, 0x00, 0x00, 0x00, 0x00, 0x00,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 0x00, 0x00};
const unsigned char load11[] U8X8_PROGMEM = {0x00, 0x00, 0x00, 0x00, 0x00, 0x00, 0x00, 0x00, 0x00, 0x00, 0x00, 0x00, 0x00,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 0x03, 0x00};
const unsigned char load12[] U8X8_PROGMEM = {0x00, 0x00, 0x00, 0x00, 0x00, 0x00, 0x00, 0x00, 0x00, 0x00, 0x00, 0x00, 0x00,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 0x0f, 0x00};
const unsigned char load13[] U8X8_PROGMEM = {0x00, 0x00, 0x00, 0x00, 0x00, 0x00, 0x00, 0x00, 0x00, 0x00, 0x00, 0x00, 0x00,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 0x0f, 0x00};
const unsigned char load14[] U8X8_PROGMEM = {0x00, 0x00, 0x00, 0x00, 0x00, 0x00, 0x00, 0x00, 0x00, 0x00, 0x00, 0x00, 0x00,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 0x00, 0x00};
const unsigned char load15[] U8X8_PROGMEM = {0x00, 0x00, 0x00, 0x00, 0x00, 0x00, 0x00, 0x00, 0x00, 0x00, 0x00, 0x00, 0x00,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 0x00, 0x00};
const unsigned char load16[] U8X8_PROGMEM = {0x00, 0x00, 0x00, 0x00, 0x00, 0x00, 0x00, 0x00, 0x00, 0x00, 0x00, 0x00, 0x00,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 0x00, 0x00};
const unsigned char load17[] U8X8_PROGMEM = {0x00, 0x00, 0x00, 0x00, 0x00, 0x00, 0x00, 0x00, 0x00, 0x00, 0x00, 0x00, 0x00,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 0x00, 0x00};
const unsigned char load18[] U8X8_PROGMEM = {0x00, 0x00, 0x00, 0x00, 0x00, 0x00, 0x00, 0x00, 0x00, 0x00, 0x00, 0x00, 0x00,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 0x00, 0x00};
const unsigned char load19[] U8X8_PROGMEM = {0x00, 0x00, 0x00, 0x00, 0x00, 0x00, 0x00, 0x00, 0x00, 0x00, 0x00, 0x00, 0x00,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 0x00, 0x00};
const unsigned char load20[] U8X8_PROGMEM = {0x00, 0x00, 0x00, 0x00, 0x00, 0x00, 0x00, 0x00, 0x00, 0x00, 0x00, 0x00, 0x00,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 0x00, 0x00};
const unsigned char load21[] U8X8_PROGMEM = {0x00, 0x00, 0x00, 0x00, 0x00, 0x00, 0x00, 0x00, 0x00, 0x00, 0x00, 0xc0, 0x07,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 0x00, 0x00};
const unsigned char load22[] U8X8_PROGMEM = {0x00, 0x00, 0x00, 0x00, 0x00, 0x00, 0x00, 0x00, 0x00, 0x00, 0x00, 0xe0, 0x0f,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 0x00, 0x00};
const unsigned char load23[] U8X8_PROGMEM = {0x00, 0x00, 0x00, 0x00, 0x00, 0x00, 0x00, 0x00, 0x00, 0x00, 0x00, 0xe0, 0x0f,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 0x00, 0x00};
const unsigned char load24[] U8X8_PROGMEM = {0x00, 0x00, 0x00, 0x00, 0x00, 0x00, 0x00, 0x00, 0x00, 0x00, 0x00, 0xe0, 0x0f,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 0x00, 0x00};
const unsigned char load25[] U8X8_PROGMEM = {0x00, 0x00, 0x00, 0x00, 0x00, 0x00, 0x00, 0x00, 0x00, 0x00, 0x00, 0xe0, 0x0f,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 0x00, 0x00};
const unsigned char load26[] U8X8_PROGMEM = {0x00, 0x00, 0x00, 0x00, 0x00, 0x00, 0x00, 0x00, 0x00, 0x00, 0x00, 0xe0, 0x0f,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 0x00, 0x00};
const unsigned char load27[] U8X8_PROGMEM = {0x00, 0x00, 0x00, 0x00, 0x00, 0x00, 0x00, 0x00, 0x00, 0x00, 0x00, 0xc0, 0x07,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 0x00, 0x00};
const unsigned char load28[] U8X8_PROGMEM = {0x00, 0x00, 0x00, 0x00, 0x00, 0x00, 0x00, 0x00, 0x00, 0x00, 0x00, 0x00, 0x00,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 0x00, 0x00};
// 加载动画数组 loading array
const unsigned char *const gifList[] U8X8_PROGMEM = {load1, load2, load3, load4, load5, load6, load7, load8, load9, load10, load11, load12, load13, load14, load15, load16, load17, load18, load19, load20, load21, load22, load23, load24, load25, load26, load27, load28};
Ticker isCON;               // 检测连接定时器
Ticker gifTicker;           // 更新loading gif 数组索引定时器
Ticker getServerInfoTicker; // 连接成功后定时向服务器获取请求
Ticker swInfoTimer;         // 切换信息显示帧

Ticker drawInfoTimer;
WiFiClient client;
const char *SSID = "OpenWrt";            // WiFi名 SSID
const char *SSIDPW = "";                 // WiFi密码,没有留空 SSISPASSWORD
const String ServerIP = "192.168.10.59"; // 服务器地址
const int ServerPort = 553;              // 服务器端口
byte CONStatusCode = 0;
byte CONTimer = 24; // *连接计时器
byte gifIndex = 0;  // *loading gif帧数组索引
bool loadGIndxFstTimer = 1;
byte ServerLoading = 1;           // *服务器是否加载中flag
byte infoIndex = 0;               // *信息显示帧 (轮播)
const long infoSwitchTime = 4000; // 信息轮播时间间隔3秒
void setup()
{
    // //pinMode(LED_BUILTIN, OUTPUT);
    // digitalWrite(LED_BUILTIN, 0);
    Serial.begin(9600);
    WiFi.mode(WIFI_STA);
    WiFi.begin(SSID, SSIDPW);
    u8g2.begin();
    isCON.once_ms(200, isCONFun);                     // 定时检测连接状态
    getServerInfoTicker.attach(2, getServaerInfo);    // 定时获取服务器信息
    swInfoTimer.once_ms(infoSwitchTime, infoIndexSw); // 开启切换信息显示帧
}
void loop()
{
    if (CONStatusCode < 2) // 未连接服务器,根据连接检测更新的状态码来重连各级连接
    {
        switch (CONStatusCode)
        {
        case 0:
            if (CONTimer >= 50) // 10 秒超时重连
            {
                WiFi.printDiag(Serial);
                //Serial.println("WiFi未连接,尝试重新连接");
                WiFi.disconnect();
                WiFi.begin(SSID, SSIDPW); // 尝试重新连接WiFi
                CONTimer = 0;
            };
            break;
        case 1:
            if (CONTimer >= 50) // 5 秒超时重连服务器
            {
                WiFi.printDiag(Serial);
                //Serial.println("服务器未连接,尝试重新连接");
                client.stop();
                client.connect(ServerIP, ServerPort);
                CONTimer = 0;
            };
        }
    }
    OLEDDraw();
}
// 定时检测客户端和服务器的连接状态并更新连接状态码,以及重连后的重置重连中的操作
void isCONFun()
{
    isCON.once_ms(200, isCONFun);      // 保持下次定时器
    if (WiFi.status() != WL_CONNECTED) // WiFi未连接
    {
        CONStatusCode = 0; // 降级连接状态检测码
        CONTimer++;        // 开启重连WiFi定时器
        return;
    }
    else
    {
        if (CONStatusCode < 1) // WiFi已连接,但状态码为未连接WiFi值修复状态码(也可看做重连成功部分)
        {
            CONStatusCode = 1;     // 更新状态码
            CONTimer = 49;         // 重置loop中的重连超时计数器
            gifTicker.detach();    // 关闭索引定时器
            loadGIndxFstTimer = 1; // 重置索引定时器开启开关为开,以便下次连接加载动画使用
        }
    }
    // 连接服务器部分
    if (!client.connected()) // 未连接到服务器
    {
        CONStatusCode = 1; // 降级连接状态检测码为连接WiFi未连接服务器1
        CONTimer++;        // 开启重连WiFi定时器
        //if()
        return; // 不在执行下面的服务器连接检测,无意义
    }
    else
    {
        //Serial.println(CONStatusCode);
        if (CONStatusCode < 2) // 服务器已连接,但状态码为未连接WiFi值修复状态码
        {
            CONStatusCode = 2;     // 更新状态码
            CONTimer = 24;         // 重置loop中的重连超时计数器
            gifTicker.detach();    // 关闭索引定时器
            loadGIndxFstTimer = 1; // 重置索引定时器开启开关为开,以便下次连接加载动画使用}
        }
    }
}
// 根据状态码来更新屏幕显示内容
void OLEDDraw()
{
    switch (CONStatusCode)
    {
    case 0: // WiFi未连接显式内容
        //开启一个定时器更新索引,没有更新状态码只能执行一次"开启帧定时器",除非状态码更新,但状态码更新要确保上次状态码的帧处理定时器关闭
        OLEDLoadDraw(gifList, 66 + 12, 0, wifi2, 0, 0, "WiFi", 0, 64 - 16, 0, 64);
        break;
    case 1:
        OLEDLoadDraw(gifList, -15, 0, server, 128 - 32, 0, "Server", 128 - getFontWidth(u8g2_font_helvB12_te, "Server"), 64 - 16, 128 - getFontWidth(u8g2_font_t0_16b_tf, "Server") - 32, 64);
        break;
    case 2:
        if (ServerLoading)
        {
            OLEDLoadDraw(gifList, -15, 0, link, 128 - 32, 0, "link", 128 - getFontWidth(u8g2_font_helvB12_te, "Link"), 64 - 16, 128 - getFontWidth(u8g2_font_t0_16b_tf, "Server") - 32, 64);
        }
        else
        {
            gifTicker.detach();    // 关闭索引定时器
            loadGIndxFstTimer = 1; // 重置索引定时器开启开关为开,以便下次连接加载动画使用
            OLEDInfoDraw();
        }
        break;
    }
}

// Loading动画帧处理
void gifIndexSw()
{
    if (++gifIndex >= 28)
        gifIndex = 0;
    gifTicker.once_ms(30, gifIndexSw);
}
// 未连接服务的加载界面 可以自定义,参数很多;吐槽下c语言的数据类型:老奶奶的裹脚布,又臭又长 your mother f*ck;
void OLEDLoadDraw(const unsigned char *const *gifList, unsigned int gifX, int gifY, const unsigned char *icon, int iconX, int iconY, const char *Heading, int HeadingX, int HeadingY, int tipsX, int tipsY)
{
    u8g2.clearBuffer();
    if (loadGIndxFstTimer) // 开启gif索引定时器
    {
        gifTicker.once_ms(15, gifIndexSw);
        loadGIndxFstTimer = 0; // 关闭
    }
    u8g2.drawXBMP(gifX, gifY, 64, 64, gifList[gifIndex]);
    u8g2.drawXBMP(iconX, iconY, 32, 32, icon);
    u8g2.setFont(u8g2_font_helvB12_te); //u8g2_font_helvB12_te
    u8g2.drawStr(HeadingX, HeadingY, Heading);
    u8g2.setFont(u8g2_font_t0_16b_tf);
    //u8g2_font_9x18_tf
    u8g2.drawStr(tipsX, tipsY, "Connection");
    u8g2.sendBuffer();
}

void getServaerInfo()
{
    if (CONStatusCode < 2) // 没连接到服务端作甚?
        return;
    client.write("get");    // 请求数据
    Tcp_Handler(readTcp()); // 数据处理
}
// 获取tcp服务端数据
void Tcp_Handler(String data)
{
    String tempStr = "";
    //Serial.println(data);
    if (!(data.charAt(0) == '?' && data.charAt(data.length() - 1) == '!')) // 字符不是?-!形式
        ServerLoading = 1;                                                 // 服务器初始化中
    else
    {
        ServerLoading = 0; // 关闭加载动画
        // 去掉首尾字符
        data = (data.substring(1, data.length() - 1)).substring(0, data.length() - 2);
        // 处理获取到的字符到信息数组中infoArr

        for (int i = 0; i < 3; i++) // 遍历字符串
        {
            tempStr = (getValue(data, '-', i));
            for (int j = 0; j < 6; j++)
            {

                infoArr[i][j] = getValue(tempStr, '@', j);
            } // value
        }
    }
    // 数组赋值完成后应该是这个样子
    // [[icon,key,value],[icon,key,value],[icon,key,value],[icon,key,value]]
}
//数据处理
String readTcp()
{
    String data = "";
    while (client.available() > 0)
    {
        data += char(client.read()); // 读取数据
    }
    return data;
}

// 字符串截取
String getValue(String data, char separator, int index)
{
    int found = 0;
    int strIndex[] = {0, -1};
    int maxIndex = data.length() - 1;

    for (int i = 0; i <= maxIndex && found <= index; i++)
    {
        if (data.charAt(i) == separator || i == maxIndex)
        {
            found++;
            strIndex[0] = strIndex[1] + 1;
            strIndex[1] = (i == maxIndex) ? i + 1 : i;
        }
    }
    return found > index ? data.substring(strIndex[0], strIndex[1]) : "";
}
void OLEDInfoDraw()
{
    u8g2.setFontMode(1); // 开启字体周围透明
    u8g2.clearBuffer();
    // 将数组的值类型转换
    const char *keyChar = infoArr[infoIndex][2].c_str(),
               *valueChar = infoArr[infoIndex][3].c_str(),
               *unitChar = infoArr[infoIndex][4].c_str(),
               *allChar = infoArr[infoIndex][5].c_str();
    String VU = infoArr[infoIndex][3] + infoArr[infoIndex][4]; // value+unit
    int view = infoArr[infoIndex][0].toInt(), iconIndex = infoArr[infoIndex][1].toInt();
    float pl = atof(valueChar) / atof(allChar); // 已用占比
    //Serial.println(pl);
    int HH;
    String ListInfoArr[4];
    char pc[3];
    itoa(int(pl * 100), pc, 10);
    String pcstr(pc);
    pcstr.concat("%");
    // 视图模式
    switch (view)
    {
    case 1: // 大字样式
        // u8g2.drawXBMP(128 - 32, 0, 32, 32, iconList[iconIndex]); //icon 右上角
        // u8g2.setFont(u8g2_font_courB18_tf);
        // u8g2.drawStr(0, 32 - 7, keyChar); //6个字符 一个字符key
        // u8g2.setFont(u8g2_font_10x20_mn);
        // u8g2.drawStr(80 - 8 * 10, 64, valueChar); // value
        // u8g2.setFont(u8g2_font_profont17_mf);
        // u8g2.drawStr(80 + 4, 64, unitChar); //unit单位
        // 以上是带图标样式,有点丑,以弃用
        //标题;备用字体:  u8g2_font_bauhaus2015_tr u8g2_font_helvB12_tr   u8g2_font_lastapprenticebold_tr  u8g2_font_tallpix_tr
        u8g2.setFont(u8g2_font_lastapprenticebold_tr);
        HH = u8g2.getMaxCharHeight();
        u8g2.drawStr((128 - u8g2.getUTF8Width(keyChar)) / 2, 17, keyChar); // 最高17
        u8g2.setFont(u8g2_font_freedoomr25_tn);
        // value
        u8g2.drawStr(128 - u8g2.getUTF8Width(valueChar) - 34, 50, valueChar); // 这个字体有点上移,+3

        u8g2.drawRBox(96, 23, 32, 12, 3); // 百分比框
        u8g2.drawRBox(96, 36, 32, 12, 3); // 单位框
        u8g2.setDrawColor(0);             // 文字颜色异或
        u8g2.setFont(u8g2_font_t0_14b_mr);
        u8g2.drawStr(96 + (32 - u8g2.getUTF8Width(pcstr.c_str())) / 2, 50 - 16, pcstr.c_str()); // 单位文字
        u8g2.drawStr(96 + (32 - u8g2.getUTF8Width(unitChar)) / 2, 50 - 3, unitChar);            // 单位文字
        // 进度条
        u8g2.setDrawColor(1);
        u8g2.drawFrame(0, 52, 128, 12); //
        u8g2.drawBox(0 + 2, 52 + 2, (int(floor(pl * (128 - 2 * 2)))), 8);

        break;
    case 2: // 视图2样式 进度条样式,没辙了搞个骚操作,你要扩展也可搞骚操作,我坑给你留了,你来埋

        u8g2.setFont(u8g2_font_mercutio_basic_nbp_tf);                     //infoArr[i][3].concat(infoArr[i][4]) u8g2_font_t0_16_mf
        u8g2.drawStr(0, 14, keyChar);                                      // 最好使用大写字母,不超过5个字符
        u8g2.drawStr(128 - u8g2.getUTF8Width(VU.c_str()), 14, VU.c_str()); //单位不超过4个,value不超过6个
        u8g2.drawRFrame(0, 16, 128, 16, 0);
        u8g2.drawRBox(0 + 2, 16 + 2, int(floor(atof(valueChar) / atof(allChar) * (128 - 4))), 16 - 2 * 2, 0); //v/a*124取整+                                                                                                       // 可以扩展为更多注意修改上面的进度条的样式
        // 第二行 数据格式 key#value#unit#all
        for (int i = 0; i < 4; i++) // 提取infoArr本应该是图标索引的字符串
        {
            ListInfoArr[i] = getValue(infoArr[infoIndex][1], '#', i);                                                                         //反正进图条也不需要图标,借用一下
        }                                                                                                                                     //infoArr[i][3].concat(infoArr[i][4])
        u8g2.drawStr(0, 32 + 14, ListInfoArr[0].c_str());                                                                                     //key                                                                            // 最好使用大写字母,不超过5个字符
        u8g2.drawStr(128 - u8g2.getUTF8Width((ListInfoArr[1] + ListInfoArr[2]).c_str()), 32 + 14, (ListInfoArr[1] + ListInfoArr[2]).c_str()); //单位不超过4个,value不超过6个
        // 我是写懵逼了,你看懵逼了吗,c艹
        u8g2.drawRFrame(0, 32 + 16, 128, 16, 0);
        u8g2.drawRBox(0 + 2, 32 + 16 + 2, int(floor(atof(ListInfoArr[1].c_str()) / atof(ListInfoArr[3].c_str()) * (128 - 4))), 16 - 2 * 2, 0); //v/a*124取整+                                                                                                       // 可以扩展为更多注意修改上面的进度条的样式
        break;
    case 3:
        u8g2.drawRBox(0, 0, 128, 64, 0);
    }
    u8g2.sendBuffer();
}
// 切换信息显示帧
void infoIndexSw()
{
    if (++infoIndex >= 3)
        infoIndex = 0;
    swInfoTimer.once_ms(infoSwitchTime, infoIndexSw);
}
// 获取字符宽度
int getFontWidth(const uint8_t *font, const char *str)
{
    u8g2.setFont(font);
    return u8g2.getUTF8Width(str);
}